## firmware/esp_ble_mesh_gateway/sdkconfig.defaults
```kconfig
# BoatConnect BLE Mesh gateway defaults.
# Acts as Provisioner + GATT Proxy so the host laptop is not required for
# enrolling boats. Forwards received vendor messages verbatim to UART0.

CONFIG_BT_ENABLED=y
CONFIG_BT_BLUEDROID_ENABLED=y
CONFIG_BT_BLE_ENABLED=y
CONFIG_BTDM_CTRL_MODE_BLE_ONLY=y

CONFIG_BLE_MESH=y
CONFIG_BLE_MESH_NODE=y
CONFIG_BLE_MESH_PROVISIONER=y
CONFIG_BLE_MESH_PB_ADV=y
CONFIG_BLE_MESH_PB_GATT=y
CONFIG_BLE_MESH_GATT_PROXY_SERVER=y
CONFIG_BLE_MESH_RELAY=y
CONFIG_BLE_MESH_LOW_POWER=n
CONFIG_BLE_MESH_FRIEND=n
CONFIG_BLE_MESH_SETTINGS=y

# Allow several boats per fleet.
CONFIG_BLE_MESH_MAX_PROV_NODES=20
CONFIG_BLE_MESH_PBA_SAME_TIME=2
CONFIG_BLE_MESH_PBG_SAME_TIME=2

CONFIG_BLE_MESH_TRACE_LEVEL_WARNING=y
```

## firmware/esp_ble_mesh_node/sdkconfig.defaults
```kconfig
# BoatConnect BLE Mesh node defaults
# Bluedroid host with BLE-only controller; Mesh Relay enabled so boats hop frames
# toward the gateway when out of single-hop range.

CONFIG_BT_ENABLED=y
CONFIG_BT_BLUEDROID_ENABLED=y
CONFIG_BT_BLE_ENABLED=y
CONFIG_BT_CONTROLLER_ONLY=n
CONFIG_BTDM_CTRL_MODE_BLE_ONLY=y
CONFIG_BTDM_CTRL_MODE_BR_EDR_ONLY=n
CONFIG_BTDM_CTRL_MODE_BTDM=n

CONFIG_BLE_MESH=y
CONFIG_BLE_MESH_NODE=y
CONFIG_BLE_MESH_PROVISIONER=n
CONFIG_BLE_MESH_PB_ADV=y
CONFIG_BLE_MESH_PB_GATT=y
CONFIG_BLE_MESH_GATT_PROXY_SERVER=n
CONFIG_BLE_MESH_RELAY=y
CONFIG_BLE_MESH_LOW_POWER=n
CONFIG_BLE_MESH_FRIEND=n
CONFIG_BLE_MESH_SETTINGS=y

# Larger access-layer payloads so a full BTC1 frame fits in one segmented PDU.
CONFIG_BLE_MESH_TRACE_LEVEL_WARNING=y
```
